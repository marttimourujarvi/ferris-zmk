## config/west.yml
```yaml
manifest:
  defaults:
    revision: v0.3
  remotes:
    - name: zmkfirmware
      url-base: https://github.com/zmkfirmware
    - name: urob
      url-base: https://github.com/urob
    - name: locales
      url-base: https://github.com/joelspadin
    - name: dhruvinsh
      url-base: https://github.com/dhruvinsh
    # Additional modules containing boards/shields/custom code can be listed here as well
    # See https://docs.zephyrproject.org/3.2.0/develop/west/manifest.html#projects
  projects:
    - name: zmk
      remote: zmkfirmware
      import: app/west.yml
    - name: zmk-auto-layer
      remote: urob
    - name: zmk-helpers
      remote: urob
      revision: main
    - name: zmk-locales
      remote: locales
      revision: v1.1.0
    - name: zmk-adaptive-key
      remote: urob
    - name: zmk-tri-state
      remote: dhruvinsh
      revision: main
  self:
    path: config
```
